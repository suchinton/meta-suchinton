## conf/layer.conf
```bitbake
# We have a conf and classes directory, add to BBPATH
BBPATH .= ":${LAYERDIR}"

# We have recipes-* directories, add to BBFILES
BBFILES += "${LAYERDIR}/recipes-*/*/*.bb \
            ${LAYERDIR}/recipes-*/*/*.bbappend"

BBFILE_COLLECTIONS += "meta-suchinton"
BBFILE_PATTERN_meta-suchinton = "^${LAYERDIR}/"
BBFILE_PRIORITY_meta-suchinton = "6"

LAYERDEPENDS_meta-suchinton = "core"
LAYERSERIES_COMPAT_meta-suchinton = "kirkstone"
```
